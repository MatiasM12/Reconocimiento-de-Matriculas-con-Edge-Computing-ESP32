## main/Kconfig
```kconfig
    menu "Camera Pinout Configuration"
        menu "WiFi Setting"

            config ESPCAM_WIFI_SSID
                string "WiFi SSID"
                default "myssid"
                help
                    SSID (network name) to connect to.
    
            config ESPCAM_WIFI_PASSWORD
                string "WiFi Password"
                default "mypassword"
                help
                    WiFi password (WPA or WPA2) to connect to.
    
            config ESPCAM_MAXIMUM_RETRY
                int "Maximum retry"
                default 5
                help
                    Set the Maximum retry to avoid station reconnecting to the AP unlimited when the AP is really inexistent.
        endmenu
        
        choice CAMERA_MODULE
            bool "Select Camera Pinout"
            default CAMERA_MODULE_ESP_EYE
            help
                Select Camera Pinout.

            config CAMERA_MODULE_ESP_EYE
                bool "ESP-EYE DevKit"
            config CAMERA_MODULE_ESP_S3_EYE
                bool "ESP-S3-EYE DevKit"
            config CAMERA_MODULE_AI_THINKER
                bool "ESP32-CAM by AI-Thinker"
        endchoice
    endmenu
```
